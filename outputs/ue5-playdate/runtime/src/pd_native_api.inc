// Generated by tools/generate-native-api.py; all guest pointers are 32-bit.
static const ApiTableDef native_tables[] = {
    {"", 10},
    {"system", 54},
    {"file", 13},
    {"graphics", 71},
    {"graphics.video", 8},
    {"graphics.tilemap", 11},
    {"graphics.videostream", 11},
    {"sprite", 66},
    {"display", 10},
    {"sound", 25},
    {"sound.channel", 17},
    {"sound.fileplayer", 24},
    {"sound.sample", 8},
    {"sound.sampleplayer", 19},
    {"sound.synth", 30},
    {"sound.sequence", 20},
    {"sound.effect", 13},
    {"sound.effect.twopolefilter", 10},
    {"sound.effect.onepolefilter", 5},
    {"sound.effect.bitcrusher", 15},
    {"sound.effect.ringmodulator", 5},
    {"sound.effect.delayline", 10},
    {"sound.effect.overdrive", 9},
    {"sound.lfo", 15},
    {"sound.envelope", 12},
    {"sound.source", 4},
    {"sound.controlsignal", 6},
    {"sound.track", 17},
    {"sound.instrument", 13},
    {"sound.signal", 6},
    {"lua", 32},
    {"json", 3},
    {"scoreboards", 7},
    {"network", 7},
    {"network.http", 25},
    {"network.tcp", 17},
};
static const ApiFieldDef native_fields[] = {
    {1, 0, -1, 0},
    {1, 1, -1, 1},
    {1, 2, -1, 2},
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    {0, 9, 33, -1},
};
static const ApiFunctionDef native_functions[] = {
    {"system.realloc", "void*", "void* ptr, size_t size"},
    {"system.formatString", "int", "char **ret, const char *fmt, ..."},
    {"system.logToConsole", "void", "const char* fmt, ..."},
    {"system.error", "void", "const char* fmt, ..."},
    {"system.getLanguage", "PDLanguage", "void"},
    {"system.getCurrentTimeMilliseconds", "unsigned int", "void"},
    {"system.getSecondsSinceEpoch", "unsigned int", "unsigned int *milliseconds"},
    {"system.drawFPS", "void", "int x, int y"},
    {"system.setUpdateCallback", "void", "PDCallbackFunction* update, void* userdata"},
    {"system.getButtonState", "void", "PDButtons* current, PDButtons* pushed, PDButtons* released"},
    {"system.setPeripheralsEnabled", "void", "PDPeripherals mask"},
    {"system.getAccelerometer", "void", "float* outx, float* outy, float* outz"},
    {"system.getCrankChange", "float", "void"},
    {"system.getCrankAngle", "float", "void"},
    {"system.isCrankDocked", "int", "void"},
    {"system.setCrankSoundsDisabled", "int", "int flag"},
    {"system.getFlipped", "int", "void"},
    {"system.setAutoLockDisabled", "void", "int disable"},
    {"system.setMenuImage", "void", "LCDBitmap* bitmap, int xOffset"},
    {"system.addMenuItem", "PDMenuItem*", "const char *title, PDMenuItemCallbackFunction* callback, void* userdata"},
    {"system.addCheckmarkMenuItem", "PDMenuItem*", "const char *title, int value, PDMenuItemCallbackFunction* callback, void* userdata"},
    {"system.addOptionsMenuItem", "PDMenuItem*", "const char *title, const char** optionTitles, int optionsCount, PDMenuItemCallbackFunction* f, void* userdata"},
    {"system.removeAllMenuItems", "void", "void"},
    {"system.removeMenuItem", "void", "PDMenuItem *menuItem"},
    {"system.getMenuItemValue", "int", "PDMenuItem *menuItem"},
    {"system.setMenuItemValue", "void", "PDMenuItem *menuItem, int value"},
    {"system.getMenuItemTitle", "const char*", "PDMenuItem *menuItem"},
    {"system.setMenuItemTitle", "void", "PDMenuItem *menuItem, const char *title"},
    {"system.getMenuItemUserdata", "void*", "PDMenuItem *menuItem"},
    {"system.setMenuItemUserdata", "void", "PDMenuItem *menuItem, void *ud"},
    {"system.getReduceFlashing", "int", "void"},
    {"system.getElapsedTime", "float", "void"},
    {"system.resetElapsedTime", "void", "void"},
    {"system.getBatteryPercentage", "float", "void"},
    {"system.getBatteryVoltage", "float", "void"},
    {"system.getTimezoneOffset", "int32_t", "void"},
    {"system.shouldDisplay24HourTime", "int", "void"},
    {"system.convertEpochToDateTime", "void", "uint32_t epoch, struct PDDateTime* datetime"},
    {"system.convertDateTimeToEpoch", "uint32_t", "struct PDDateTime* datetime"},
    {"system.clearICache", "void", "void"},
    {"system.setButtonCallback", "void", "PDButtonCallbackFunction* cb, void* buttonud, int queuesize"},
    {"system.setSerialMessageCallback", "void", "void (*callback)(const char* data)"},
    {"system.vaFormatString", "int", "char **outstr, const char *fmt, va_list args"},
    {"system.parseString", "int", "const char *str, const char *format, ..."},
    {"system.delay", "void", "uint32_t milliseconds"},
    {"system.getServerTime", "void", "void (*callback)(const char* time, const char* err)"},
    {"system.restartGame", "void", "const char* launchargs"},
    {"system.getLaunchArgs", "const char*", "const char** outpath"},
    {"system.sendMirrorData", "bool", "uint8_t command, void* data, int len"},
    {"system.getSystemInfo", "const struct PDInfo*", "void"},
    {"system.getLocalizedText", "char*", "const char *key, PDLanguage language"},
    {"system.getVolume", "float", "void"},
    {"system.getPowerStatus", "PDPowerStatus", "void"},
    {"system.exitToLauncher", "void", "void"},
    {"file.geterr", "const char*", "void"},
    {"file.listfiles", "int", "const char* path, void (*callback)(const char* path, void* userdata), void* userdata, int showhidden"},
    {"file.stat", "int", "const char* path, FileStat* stat"},
    {"file.mkdir", "int", "const char* path"},
    {"file.unlink", "int", "const char* name, int recursive"},
    {"file.rename", "int", "const char* from, const char* to"},
    {"file.open", "SDFile*", "const char* name, FileOptions mode"},
    {"file.close", "int", "SDFile* file"},
    {"file.read", "int", "SDFile* file, void* buf, unsigned int len"},
    {"file.write", "int", "SDFile* file, const void* buf, unsigned int len"},
    {"file.flush", "int", "SDFile* file"},
    {"file.tell", "int", "SDFile* file"},
    {"file.seek", "int", "SDFile* file, int pos, int whence"},
    {"graphics.video.loadVideo", "LCDVideoPlayer*", "const char* path"},
    {"graphics.video.freePlayer", "void", "LCDVideoPlayer* p"},
    {"graphics.video.setContext", "int", "LCDVideoPlayer* p, LCDBitmap* context"},
    {"graphics.video.useScreenContext", "void", "LCDVideoPlayer* p"},
    {"graphics.video.renderFrame", "int", "LCDVideoPlayer* p, int n"},
    {"graphics.video.getError", "const char*", "LCDVideoPlayer* p"},
    {"graphics.video.getInfo", "void", "LCDVideoPlayer* p, int* outWidth, int* outHeight, float* outFrameRate, int* outFrameCount, int* outCurrentFrame"},
    {"graphics.video.getContext", "LCDBitmap*", "LCDVideoPlayer *p"},
    {"graphics.clear", "void", "LCDColor color"},
    {"graphics.setBackgroundColor", "void", "LCDSolidColor color"},
    {"graphics.setStencil", "void", "LCDBitmap* stencil"},
    {"graphics.setDrawMode", "LCDBitmapDrawMode", "LCDBitmapDrawMode mode"},
    {"graphics.setDrawOffset", "void", "int dx, int dy"},
    {"graphics.setClipRect", "void", "int x, int y, int width, int height"},
    {"graphics.clearClipRect", "void", "void"},
    {"graphics.setLineCapStyle", "void", "LCDLineCapStyle endCapStyle"},
    {"graphics.setFont", "void", "LCDFont* font"},
    {"graphics.setTextTracking", "void", "int tracking"},
    {"graphics.pushContext", "void", "LCDBitmap* target"},
    {"graphics.popContext", "void", "void"},
    {"graphics.drawBitmap", "void", "LCDBitmap* bitmap, int x, int y, LCDBitmapFlip flip"},
    {"graphics.tileBitmap", "void", "LCDBitmap* bitmap, int x, int y, int width, int height, LCDBitmapFlip flip"},
    {"graphics.drawLine", "void", "int x1, int y1, int x2, int y2, int width, LCDColor color"},
    {"graphics.fillTriangle", "void", "int x1, int y1, int x2, int y2, int x3, int y3, LCDColor color"},
    {"graphics.drawRect", "void", "int x, int y, int width, int height, LCDColor color"},
    {"graphics.fillRect", "void", "int x, int y, int width, int height, LCDColor color"},
    {"graphics.drawEllipse", "void", "int x, int y, int width, int height, int lineWidth, float startAngle, float endAngle, LCDColor color"},
    {"graphics.fillEllipse", "void", "int x, int y, int width, int height, float startAngle, float endAngle, LCDColor color"},
    {"graphics.drawScaledBitmap", "void", "LCDBitmap* bitmap, int x, int y, float xscale, float yscale"},
    {"graphics.drawText", "int", "const void* text, size_t len, PDStringEncoding encoding, int x, int y"},
    {"graphics.newBitmap", "LCDBitmap*", "int width, int height, LCDColor bgcolor"},
    {"graphics.freeBitmap", "void", "LCDBitmap*"},
    {"graphics.loadBitmap", "LCDBitmap*", "const char* path, const char** outerr"},
    {"graphics.copyBitmap", "LCDBitmap*", "LCDBitmap* bitmap"},
    {"graphics.loadIntoBitmap", "void", "const char* path, LCDBitmap* bitmap, const char** outerr"},
    {"graphics.getBitmapData", "void", "LCDBitmap* bitmap, int* width, int* height, int* rowbytes, uint8_t** mask, uint8_t** data"},
    {"graphics.clearBitmap", "void", "LCDBitmap* bitmap, LCDColor bgcolor"},
    {"graphics.rotatedBitmap", "LCDBitmap*", "LCDBitmap* bitmap, float rotation, float xscale, float yscale, int* allocedSize"},
    {"graphics.newBitmapTable", "LCDBitmapTable*", "int count, int width, int height"},
    {"graphics.freeBitmapTable", "void", "LCDBitmapTable* table"},
    {"graphics.loadBitmapTable", "LCDBitmapTable*", "const char* path, const char** outerr"},
    {"graphics.loadIntoBitmapTable", "void", "const char* path, LCDBitmapTable* table, const char** outerr"},
    {"graphics.getTableBitmap", "LCDBitmap*", "LCDBitmapTable* table, int idx"},
    {"graphics.loadFont", "LCDFont*", "const char* path, const char** outErr"},
    {"graphics.getFontPage", "LCDFontPage*", "LCDFont* font, uint32_t c"},
    {"graphics.getPageGlyph", "LCDFontGlyph*", "LCDFontPage* page, uint32_t c, LCDBitmap** bitmap, int* advance"},
    {"graphics.getGlyphKerning", "int", "LCDFontGlyph* glyph, uint32_t glyphcode, uint32_t nextcode"},
    {"graphics.getTextWidth", "int", "LCDFont* font, const void* text, size_t len, PDStringEncoding encoding, int tracking"},
    {"graphics.getFrame", "uint8_t*", "void"},
    {"graphics.getDisplayFrame", "uint8_t*", "void"},
    {"graphics.getDebugBitmap", "LCDBitmap*", "void"},
    {"graphics.copyFrameBufferBitmap", "LCDBitmap*", "void"},
    {"graphics.markUpdatedRows", "void", "int start, int end"},
    {"graphics.display", "void", "void"},
    {"graphics.setColorToPattern", "void", "LCDColor* color, LCDBitmap* bitmap, int x, int y"},
    {"graphics.checkMaskCollision", "int", "LCDBitmap* bitmap1, int x1, int y1, LCDBitmapFlip flip1, LCDBitmap* bitmap2, int x2, int y2, LCDBitmapFlip flip2, LCDRect rect"},
    {"graphics.setScreenClipRect", "void", "int x, int y, int width, int height"},
    {"graphics.fillPolygon", "void", "int nPoints, int* coords, LCDColor color, LCDPolygonFillRule fillrule"},
    {"graphics.getFontHeight", "uint8_t", "LCDFont* font"},
    {"graphics.getDisplayBufferBitmap", "LCDBitmap*", "void"},
    {"graphics.drawRotatedBitmap", "void", "LCDBitmap* bitmap, int x, int y, float rotation, float centerx, float centery, float xscale, float yscale"},
    {"graphics.setTextLeading", "void", "int lineHeightAdustment"},
    {"graphics.setBitmapMask", "int", "LCDBitmap* bitmap, LCDBitmap* mask"},
    {"graphics.getBitmapMask", "LCDBitmap*", "LCDBitmap* bitmap"},
    {"graphics.setStencilImage", "void", "LCDBitmap* stencil, int tile"},
    {"graphics.makeFontFromData_deprecated", "LCDFont*", "LCDFontData* data, int wide"},
    {"graphics.getTextTracking", "int", "void"},
    {"graphics.setPixel", "void", "int x, int y, LCDColor c"},
    {"graphics.getBitmapPixel", "LCDSolidColor", "LCDBitmap* bitmap, int x, int y"},
    {"graphics.getBitmapTableInfo", "void", "LCDBitmapTable* table, int* count, int* width"},
    {"graphics.drawTextInRect", "void", "const void* text, size_t len, PDStringEncoding encoding, int x, int y, int width, int height, PDTextWrappingMode wrap, PDTextAlignment align"},
    {"graphics.getTextHeightForMaxWidth", "int", "LCDFont* font, const void* text, size_t len, int maxwidth, PDStringEncoding encoding, PDTextWrappingMode wrap, int tracking, int extraLeading"},
    {"graphics.drawRoundRect", "void", "int x, int y, int width, int height, int radius, int lineWidth, LCDColor color"},
    {"graphics.fillRoundRect", "void", "int x, int y, int width, int height, int radius, LCDColor color"},
    {"graphics.tilemap.newTilemap", "LCDTileMap*", "void"},
    {"graphics.tilemap.freeTilemap", "void", "LCDTileMap* m"},
    {"graphics.tilemap.setImageTable", "void", "LCDTileMap* m, LCDBitmapTable* table"},
    {"graphics.tilemap.getImageTable", "LCDBitmapTable*", "LCDTileMap* m"},
    {"graphics.tilemap.setSize", "void", "LCDTileMap* m, int tilesWide, int tilesHigh"},
    {"graphics.tilemap.getSize", "void", "LCDTileMap* m, int* tilesWide, int* tilesHigh"},
    {"graphics.tilemap.getPixelSize", "void", "LCDTileMap* m, uint32_t* outWidth, uint32_t* outHeight"},
    {"graphics.tilemap.setTiles", "void", "LCDTileMap* m, uint16_t* indexes, int count, int rowwidth"},
    {"graphics.tilemap.setTileAtPosition", "void", "LCDTileMap* m, int x, int y, uint16_t idx"},
    {"graphics.tilemap.getTileAtPosition", "int", "LCDTileMap* m, int x, int y"},
    {"graphics.tilemap.drawAtPoint", "void", "LCDTileMap* m, float x, float y"},
    {"graphics.videostream.newPlayer", "LCDStreamPlayer*", "void"},
    {"graphics.videostream.freePlayer", "void", "LCDStreamPlayer* p"},
    {"graphics.videostream.setBufferSize", "void", "LCDStreamPlayer* p, int video, int audio"},
    {"graphics.videostream.setFile", "void", "LCDStreamPlayer* p, SDFile* file"},
    {"graphics.videostream.setHTTPConnection", "void", "LCDStreamPlayer* p, HTTPConnection* conn"},
    {"graphics.videostream.getFilePlayer", "FilePlayer*", "LCDStreamPlayer* p"},
    {"graphics.videostream.getVideoPlayer", "LCDVideoPlayer*", "LCDStreamPlayer* p"},
    {"graphics.videostream.update", "bool", "LCDStreamPlayer* p"},
    {"graphics.videostream.getBufferedFrameCount", "int", "LCDStreamPlayer* p"},
    {"graphics.videostream.getBytesRead", "uint32_t", "LCDStreamPlayer* p"},
    {"graphics.videostream.setTCPConnection", "void", "LCDStreamPlayer* p, TCPConnection* conn"},
    {"graphics.getFontGlyph", "LCDFontGlyph*", "LCDFont* font, uint32_t c, LCDBitmap** bitmap, int* advance"},
    {"graphics.makeFontFromData", "LCDFont*", "LCDFontData* data, int wide, int datalength"},
    {"sprite.setAlwaysRedraw", "void", "int flag"},
    {"sprite.addDirtyRect", "void", "LCDRect dirtyRect"},
    {"sprite.drawSprites", "void", "void"},
    {"sprite.updateAndDrawSprites", "void", "void"},
    {"sprite.newSprite", "LCDSprite*", "void"},
    {"sprite.freeSprite", "void", "LCDSprite *sprite"},
    {"sprite.copy", "LCDSprite*", "LCDSprite *sprite"},
    {"sprite.addSprite", "void", "LCDSprite *sprite"},
    {"sprite.removeSprite", "void", "LCDSprite *sprite"},
    {"sprite.removeSprites", "void", "LCDSprite **sprites, int count"},
    {"sprite.removeAllSprites", "void", "void"},
    {"sprite.getSpriteCount", "int", "void"},
    {"sprite.setBounds", "void", "LCDSprite *sprite, PDRect bounds"},
    {"sprite.getBounds", "PDRect", "LCDSprite *sprite"},
    {"sprite.moveTo", "void", "LCDSprite *sprite, float x, float y"},
    {"sprite.moveBy", "void", "LCDSprite *sprite, float dx, float dy"},
    {"sprite.setImage", "void", "LCDSprite *sprite, LCDBitmap *image, LCDBitmapFlip flip"},
    {"sprite.getImage", "LCDBitmap*", "LCDSprite *sprite"},
    {"sprite.setSize", "void", "LCDSprite *s, float width, float height"},
    {"sprite.setZIndex", "void", "LCDSprite *sprite, int16_t zIndex"},
    {"sprite.getZIndex", "int16_t", "LCDSprite *sprite"},
    {"sprite.setDrawMode", "void", "LCDSprite *sprite, LCDBitmapDrawMode mode"},
    {"sprite.setImageFlip", "void", "LCDSprite *sprite, LCDBitmapFlip flip"},
    {"sprite.getImageFlip", "LCDBitmapFlip", "LCDSprite *sprite"},
    {"sprite.setStencil", "void", "LCDSprite *sprite, LCDBitmap* stencil"},
    {"sprite.setClipRect", "void", "LCDSprite *sprite, LCDRect clipRect"},
    {"sprite.clearClipRect", "void", "LCDSprite *sprite"},
    {"sprite.setClipRectsInRange", "void", "LCDRect clipRect, int startZ, int endZ"},
    {"sprite.clearClipRectsInRange", "void", "int startZ, int endZ"},
    {"sprite.setUpdatesEnabled", "void", "LCDSprite *sprite, int flag"},
    {"sprite.updatesEnabled", "int", "LCDSprite *sprite"},
    {"sprite.setCollisionsEnabled", "void", "LCDSprite *sprite, int flag"},
    {"sprite.collisionsEnabled", "int", "LCDSprite *sprite"},
    {"sprite.setVisible", "void", "LCDSprite *sprite, int flag"},
    {"sprite.isVisible", "int", "LCDSprite *sprite"},
    {"sprite.setOpaque", "void", "LCDSprite *sprite, int flag"},
    {"sprite.markDirty", "void", "LCDSprite *sprite"},
    {"sprite.setTag", "void", "LCDSprite *sprite, uint8_t tag"},
    {"sprite.getTag", "uint8_t", "LCDSprite *sprite"},
    {"sprite.setIgnoresDrawOffset", "void", "LCDSprite *sprite, int flag"},
    {"sprite.setUpdateFunction", "void", "LCDSprite *sprite, LCDSpriteUpdateFunction *func"},
    {"sprite.setDrawFunction", "void", "LCDSprite *sprite, LCDSpriteDrawFunction *func"},
    {"sprite.getPosition", "void", "LCDSprite *sprite, float *x, float *y"},
    {"sprite.resetCollisionWorld", "void", "void"},
    {"sprite.setCollideRect", "void", "LCDSprite *sprite, PDRect collideRect"},
    {"sprite.getCollideRect", "PDRect", "LCDSprite *sprite"},
    {"sprite.clearCollideRect", "void", "LCDSprite *sprite"},
    {"sprite.setCollisionResponseFunction", "void", "LCDSprite *sprite, LCDSpriteCollisionFilterProc *func"},
    {"sprite.checkCollisions", "SpriteCollisionInfo*", "LCDSprite *sprite, float goalX, float goalY, float *actualX, float *actualY, int *len"},
    {"sprite.moveWithCollisions", "SpriteCollisionInfo*", "LCDSprite *sprite, float goalX, float goalY, float *actualX, float *actualY, int *len"},
    {"sprite.querySpritesAtPoint", "LCDSprite**", "float x, float y, int *len"},
    {"sprite.querySpritesInRect", "LCDSprite**", "float x, float y, float width, float height, int *len"},
    {"sprite.querySpritesAlongLine", "LCDSprite**", "float x1, float y1, float x2, float y2, int *len"},
    {"sprite.querySpriteInfoAlongLine", "SpriteQueryInfo*", "float x1, float y1, float x2, float y2, int *len"},
    {"sprite.overlappingSprites", "LCDSprite**", "LCDSprite *sprite, int *len"},
    {"sprite.allOverlappingSprites", "LCDSprite**", "int *len"},
    {"sprite.setStencilPattern", "void", "LCDSprite* sprite, uint8_t pattern[8]"},
    {"sprite.clearStencil", "void", "LCDSprite* sprite"},
    {"sprite.setUserdata", "void", "LCDSprite* sprite, void* userdata"},
    {"sprite.getUserdata", "void*", "LCDSprite* sprite"},
    {"sprite.setStencilImage", "void", "LCDSprite *sprite, LCDBitmap* stencil, int tile"},
    {"sprite.setCenter", "void", "LCDSprite* s, float x, float y"},
    {"sprite.getCenter", "void", "LCDSprite* s, float* x, float* y"},
    {"sprite.setTilemap", "void", "LCDSprite* s, LCDTileMap* tilemap"},
    {"sprite.getTilemap", "LCDTileMap*", "LCDSprite* s"},
    {"sprite.markDirtyRect", "void", "LCDSprite* s, PDRect rect"},
    {"display.getWidth", "int", "void"},
    {"display.getHeight", "int", "void"},
    {"display.setRefreshRate", "void", "float rate"},
    {"display.setInverted", "void", "int flag"},
    {"display.setScale", "void", "unsigned int s"},
    {"display.setMosaic", "void", "unsigned int x, unsigned int y"},
    {"display.setFlipped", "void", "int x, int y"},
    {"display.setOffset", "void", "int x, int y"},
    {"display.getRefreshRate", "float", "void"},
    {"display.getFPS", "float", "void"},
    {"sound.channel.newChannel", "SoundChannel*", "void"},
    {"sound.channel.freeChannel", "void", "SoundChannel* channel"},
    {"sound.channel.addSource", "int", "SoundChannel* channel, SoundSource* source"},
    {"sound.channel.removeSource", "int", "SoundChannel* channel, SoundSource* source"},
    {"sound.channel.addCallbackSource", "SoundSource*", "SoundChannel* channel, AudioSourceFunction* callback, void* context, int stereo"},
    {"sound.channel.addEffect", "int", "SoundChannel* channel, SoundEffect* effect"},
    {"sound.channel.removeEffect", "int", "SoundChannel* channel, SoundEffect* effect"},
    {"sound.channel.setVolume", "void", "SoundChannel* channel, float volume"},
    {"sound.channel.getVolume", "float", "SoundChannel* channel"},
    {"sound.channel.setVolumeModulator", "void", "SoundChannel* channel, PDSynthSignalValue* mod"},
    {"sound.channel.getVolumeModulator", "PDSynthSignalValue*", "SoundChannel* channel"},
    {"sound.channel.setPan", "void", "SoundChannel* channel, float pan"},
    {"sound.channel.setPanModulator", "void", "SoundChannel* channel, PDSynthSignalValue* mod"},
    {"sound.channel.getPanModulator", "PDSynthSignalValue*", "SoundChannel* channel"},
    {"sound.channel.getDryLevelSignal", "PDSynthSignalValue*", "SoundChannel* channel"},
    {"sound.channel.getWetLevelSignal", "PDSynthSignalValue*", "SoundChannel* channel"},
    {"sound.channel.getOutputAsSource", "SoundSource*", "SoundChannel* channel"},
    {"sound.fileplayer.newPlayer", "FilePlayer*", "void"},
    {"sound.fileplayer.freePlayer", "void", "FilePlayer* player"},
    {"sound.fileplayer.loadIntoPlayer", "int", "FilePlayer* player, const char* path"},
    {"sound.fileplayer.setBufferLength", "void", "FilePlayer* player, float bufferLen"},
    {"sound.fileplayer.play", "int", "FilePlayer* player, int repeat"},
    {"sound.fileplayer.isPlaying", "int", "FilePlayer* player"},
    {"sound.fileplayer.pause", "void", "FilePlayer* player"},
    {"sound.fileplayer.stop", "void", "FilePlayer* player"},
    {"sound.fileplayer.setVolume", "void", "FilePlayer* player, float left, float right"},
    {"sound.fileplayer.getVolume", "void", "FilePlayer* player, float* left, float* right"},
    {"sound.fileplayer.getLength", "float", "FilePlayer* player"},
    {"sound.fileplayer.setOffset", "void", "FilePlayer* player, float offset"},
    {"sound.fileplayer.setRate", "void", "FilePlayer* player, float rate"},
    {"sound.fileplayer.setLoopRange", "void", "FilePlayer* player, float start, float end"},
    {"sound.fileplayer.didUnderrun", "int", "FilePlayer* player"},
    {"sound.fileplayer.setFinishCallback", "void", "FilePlayer* player, sndCallbackProc callback, void* userdata"},
    {"sound.fileplayer.setLoopCallback", "void", "FilePlayer* player, sndCallbackProc callback, void* userdata"},
    {"sound.fileplayer.getOffset", "float", "FilePlayer* player"},
    {"sound.fileplayer.getRate", "float", "FilePlayer* player"},
    {"sound.fileplayer.setStopOnUnderrun", "void", "FilePlayer* player, int flag"},
    {"sound.fileplayer.fadeVolume", "void", "FilePlayer* player, float left, float right, int32_t len, sndCallbackProc finishCallback, void* userdata"},
    {"sound.fileplayer.setMP3StreamSource", "void", "FilePlayer* player, int (*dataSource)(uint8_t* data, int bytes, void* userdata), void* userdata, float bufferLen"},
    {"sound.fileplayer.setRateModulator", "void", "FilePlayer* player, PDSynthSignalValue* mod"},
    {"sound.fileplayer.getRateModulator", "PDSynthSignalValue*", "FilePlayer* player"},
    {"sound.sample.newSampleBuffer", "AudioSample*", "int byteCount"},
    {"sound.sample.loadIntoSample", "int", "AudioSample* sample, const char* path"},
    {"sound.sample.load", "AudioSample*", "const char* path"},
    {"sound.sample.newSampleFromData", "AudioSample*", "uint8_t* data, SoundFormat format, uint32_t sampleRate, int byteCount, int shouldFreeData"},
    {"sound.sample.getData", "void", "AudioSample* sample, uint8_t** data, SoundFormat* format, uint32_t* sampleRate, uint32_t* bytelength"},
    {"sound.sample.freeSample", "void", "AudioSample* sample"},
    {"sound.sample.getLength", "float", "AudioSample* sample"},
    {"sound.sample.decompress", "int", "AudioSample* sample"},
    {"sound.sampleplayer.newPlayer", "SamplePlayer*", "void"},
    {"sound.sampleplayer.freePlayer", "void", "SamplePlayer* player"},
    {"sound.sampleplayer.setSample", "void", "SamplePlayer* player, AudioSample* sample"},
    {"sound.sampleplayer.play", "int", "SamplePlayer* player, int repeat, float rate"},
    {"sound.sampleplayer.isPlaying", "int", "SamplePlayer* player"},
    {"sound.sampleplayer.stop", "void", "SamplePlayer* player"},
    {"sound.sampleplayer.setVolume", "void", "SamplePlayer* player, float left, float right"},
    {"sound.sampleplayer.getVolume", "void", "SamplePlayer* player, float* left, float* right"},
    {"sound.sampleplayer.getLength", "float", "SamplePlayer* player"},
    {"sound.sampleplayer.setOffset", "void", "SamplePlayer* player, float offset"},
    {"sound.sampleplayer.setRate", "void", "SamplePlayer* player, float rate"},
    {"sound.sampleplayer.setPlayRange", "void", "SamplePlayer* player, int start, int end"},
    {"sound.sampleplayer.setFinishCallback", "void", "SamplePlayer* player, sndCallbackProc callback, void* userdata"},
    {"sound.sampleplayer.setLoopCallback", "void", "SamplePlayer* player, sndCallbackProc callback, void* userdata"},
    {"sound.sampleplayer.getOffset", "float", "SamplePlayer* player"},
    {"sound.sampleplayer.getRate", "float", "SamplePlayer* player"},
    {"sound.sampleplayer.setPaused", "void", "SamplePlayer* player, int flag"},
    {"sound.sampleplayer.setRateModulator", "void", "SamplePlayer* player, PDSynthSignalValue* mod"},
    {"sound.sampleplayer.getRateModulator", "PDSynthSignalValue*", "SamplePlayer* player"},
    {"sound.synth.newSynth", "PDSynth*", "void"},
    {"sound.synth.freeSynth", "void", "PDSynth* synth"},
    {"sound.synth.setWaveform", "void", "PDSynth* synth, SoundWaveform wave"},
    {"sound.synth.setGenerator_deprecated", "void", "PDSynth* synth, int stereo, synthRenderFunc render, synthNoteOnFunc noteOn, synthReleaseFunc release, synthSetParameterFunc setparam, synthDeallocFunc dealloc, void* userdata"},
    {"sound.synth.setSample", "void", "PDSynth* synth, AudioSample* sample, uint32_t sustainStart, uint32_t sustainEnd"},
    {"sound.synth.setAttackTime", "void", "PDSynth* synth, float attack"},
    {"sound.synth.setDecayTime", "void", "PDSynth* synth, float decay"},
    {"sound.synth.setSustainLevel", "void", "PDSynth* synth, float sustain"},
    {"sound.synth.setReleaseTime", "void", "PDSynth* synth, float release"},
    {"sound.synth.setTranspose", "void", "PDSynth* synth, float halfSteps"},
    {"sound.synth.setFrequencyModulator", "void", "PDSynth* synth, PDSynthSignalValue* mod"},
    {"sound.synth.getFrequencyModulator", "PDSynthSignalValue*", "PDSynth* synth"},
    {"sound.synth.setAmplitudeModulator", "void", "PDSynth* synth, PDSynthSignalValue* mod"},
    {"sound.synth.getAmplitudeModulator", "PDSynthSignalValue*", "PDSynth* synth"},
    {"sound.synth.getParameterCount", "int", "PDSynth* synth"},
    {"sound.synth.setParameter", "int", "PDSynth* synth, int parameter, float value"},
    {"sound.synth.setParameterModulator", "void", "PDSynth* synth, int parameter, PDSynthSignalValue* mod"},
    {"sound.synth.getParameterModulator", "PDSynthSignalValue*", "PDSynth* synth, int parameter"},
    {"sound.synth.playNote", "void", "PDSynth* synth, float freq, float vel, float len, uint32_t when"},
    {"sound.synth.playMIDINote", "void", "PDSynth* synth, MIDINote note, float vel, float len, uint32_t when"},
    {"sound.synth.noteOff", "void", "PDSynth* synth, uint32_t when"},
    {"sound.synth.stop", "void", "PDSynth* synth"},
    {"sound.synth.setVolume", "void", "PDSynth* synth, float left, float right"},
    {"sound.synth.getVolume", "void", "PDSynth* synth, float* left, float* right"},
    {"sound.synth.isPlaying", "int", "PDSynth* synth"},
    {"sound.synth.getEnvelope", "PDSynthEnvelope*", "PDSynth* synth"},
    {"sound.synth.setWavetable", "int", "PDSynth* synth, AudioSample* sample, int log2size, int columns, int rows"},
    {"sound.synth.setGenerator", "void", "PDSynth* synth, int stereo, synthRenderFunc render, synthNoteOnFunc noteOn, synthReleaseFunc release, synthSetParameterFunc setparam, synthDeallocFunc dealloc, synthCopyUserdata copyUserdata, void* userdata"},
    {"sound.synth.copy", "PDSynth*", "PDSynth* synth"},
    {"sound.synth.clearEnvelope", "void", "PDSynth* synth"},
    {"sound.sequence.newSequence", "SoundSequence*", "void"},
    {"sound.sequence.freeSequence", "void", "SoundSequence* sequence"},
    {"sound.sequence.loadMIDIFile", "int", "SoundSequence* seq, const char* path"},
    {"sound.sequence.getTime", "uint32_t", "SoundSequence* seq"},
    {"sound.sequence.setTime", "void", "SoundSequence* seq, uint32_t time"},
    {"sound.sequence.setLoops", "void", "SoundSequence* seq, int loopstart, int loopend, int loops"},
    {"sound.sequence.getTempo_deprecated", "int", "SoundSequence* seq"},
    {"sound.sequence.setTempo", "void", "SoundSequence* seq, float stepsPerSecond"},
    {"sound.sequence.getTrackCount", "int", "SoundSequence* seq"},
    {"sound.sequence.addTrack", "SequenceTrack*", "SoundSequence* seq"},
    {"sound.sequence.getTrackAtIndex", "SequenceTrack*", "SoundSequence* seq, unsigned int track"},
    {"sound.sequence.setTrackAtIndex", "void", "SoundSequence* seq, SequenceTrack* track, unsigned int idx"},
    {"sound.sequence.allNotesOff", "void", "SoundSequence* seq"},
    {"sound.sequence.isPlaying", "int", "SoundSequence* seq"},
    {"sound.sequence.getLength", "uint32_t", "SoundSequence* seq"},
    {"sound.sequence.play", "void", "SoundSequence* seq, SequenceFinishedCallback finishCallback, void* userdata"},
    {"sound.sequence.stop", "void", "SoundSequence* seq"},
    {"sound.sequence.getCurrentStep", "int", "SoundSequence* seq, int* timeOffset"},
    {"sound.sequence.setCurrentStep", "void", "SoundSequence* seq, int step, int timeOffset, int playNotes"},
    {"sound.sequence.getTempo", "float", "SoundSequence* seq"},
    {"sound.effect.newEffect", "SoundEffect*", "effectProc* proc, void* userdata"},
    {"sound.effect.freeEffect", "void", "SoundEffect* effect"},
    {"sound.effect.setMix", "void", "SoundEffect* effect, float level"},
    {"sound.effect.setMixModulator", "void", "SoundEffect* effect, PDSynthSignalValue* signal"},
    {"sound.effect.getMixModulator", "PDSynthSignalValue*", "SoundEffect* effect"},
    {"sound.effect.setUserdata", "void", "SoundEffect* effect, void* userdata"},
    {"sound.effect.getUserdata", "void*", "SoundEffect* effect"},
    {"sound.effect.twopolefilter.newFilter", "TwoPoleFilter*", "void"},
    {"sound.effect.twopolefilter.freeFilter", "void", "TwoPoleFilter* filter"},
    {"sound.effect.twopolefilter.setType", "void", "TwoPoleFilter* filter, TwoPoleFilterType type"},
    {"sound.effect.twopolefilter.setFrequency", "void", "TwoPoleFilter* filter, float frequency"},
    {"sound.effect.twopolefilter.setFrequencyModulator", "void", "TwoPoleFilter* filter, PDSynthSignalValue* signal"},
    {"sound.effect.twopolefilter.getFrequencyModulator", "PDSynthSignalValue*", "TwoPoleFilter* filter"},
    {"sound.effect.twopolefilter.setGain", "void", "TwoPoleFilter* filter, float gain"},
    {"sound.effect.twopolefilter.setResonance", "void", "TwoPoleFilter* filter, float resonance"},
    {"sound.effect.twopolefilter.setResonanceModulator", "void", "TwoPoleFilter* filter, PDSynthSignalValue* signal"},
    {"sound.effect.twopolefilter.getResonanceModulator", "PDSynthSignalValue*", "TwoPoleFilter* filter"},
    {"sound.effect.onepolefilter.newFilter", "OnePoleFilter*", "void"},
    {"sound.effect.onepolefilter.freeFilter", "void", "OnePoleFilter* filter"},
    {"sound.effect.onepolefilter.setParameter", "void", "OnePoleFilter* filter, float parameter"},
    {"sound.effect.onepolefilter.setParameterModulator", "void", "OnePoleFilter* filter, PDSynthSignalValue* signal"},
    {"sound.effect.onepolefilter.getParameterModulator", "PDSynthSignalValue*", "OnePoleFilter* filter"},
    {"sound.effect.bitcrusher.newBitCrusher", "BitCrusher*", "void"},
    {"sound.effect.bitcrusher.freeBitCrusher", "void", "BitCrusher* filter"},
    {"sound.effect.bitcrusher.setAmount", "void", "BitCrusher* filter, float amount"},
    {"sound.effect.bitcrusher.setAmountModulator", "void", "BitCrusher* filter, PDSynthSignalValue* signal"},
    {"sound.effect.bitcrusher.getAmountModulator", "PDSynthSignalValue*", "BitCrusher* filter"},
    {"sound.effect.bitcrusher.setUndersampling", "void", "BitCrusher* filter, float undersampling"},
    {"sound.effect.bitcrusher.setUndersampleModulator", "void", "BitCrusher* filter, PDSynthSignalValue* signal"},
    {"sound.effect.bitcrusher.getUndersampleModulator", "PDSynthSignalValue*", "BitCrusher* filter"},
    {"sound.effect.bitcrusher.setExponential", "void", "BitCrusher* filter, bool flag"},
    {"sound.effect.bitcrusher.setDepth", "void", "BitCrusher* filter, float amount"},
    {"sound.effect.bitcrusher.setDepthModulator", "void", "BitCrusher* filter, PDSynthSignalValue* signal"},
    {"sound.effect.bitcrusher.getDepthModulator", "PDSynthSignalValue*", "BitCrusher* filter"},
    {"sound.effect.bitcrusher.setDownsampling", "void", "BitCrusher* filter, float undersampling"},
    {"sound.effect.bitcrusher.setDownsamplingModulator", "void", "BitCrusher* filter, PDSynthSignalValue* signal"},
    {"sound.effect.bitcrusher.getDownsamplingModulator", "PDSynthSignalValue*", "BitCrusher* filter"},
    {"sound.effect.ringmodulator.newRingmod", "RingModulator*", "void"},
    {"sound.effect.ringmodulator.freeRingmod", "void", "RingModulator* filter"},
    {"sound.effect.ringmodulator.setFrequency", "void", "RingModulator* filter, float frequency"},
    {"sound.effect.ringmodulator.setFrequencyModulator", "void", "RingModulator* filter, PDSynthSignalValue* signal"},
    {"sound.effect.ringmodulator.getFrequencyModulator", "PDSynthSignalValue*", "RingModulator* filter"},
    {"sound.effect.delayline.newDelayLine", "DelayLine*", "int length, int stereo"},
    {"sound.effect.delayline.freeDelayLine", "void", "DelayLine* filter"},
    {"sound.effect.delayline.setLength", "void", "DelayLine* d, int frames"},
    {"sound.effect.delayline.setFeedback", "void", "DelayLine* d, float fb"},
    {"sound.effect.delayline.addTap", "DelayLineTap*", "DelayLine* d, int delay"},
    {"sound.effect.delayline.freeTap", "void", "DelayLineTap* tap"},
    {"sound.effect.delayline.setTapDelay", "void", "DelayLineTap* t, int frames"},
    {"sound.effect.delayline.setTapDelayModulator", "void", "DelayLineTap* t, PDSynthSignalValue* mod"},
    {"sound.effect.delayline.getTapDelayModulator", "PDSynthSignalValue*", "DelayLineTap* t"},
    {"sound.effect.delayline.setTapChannelsFlipped", "void", "DelayLineTap* t, int flip"},
    {"sound.effect.overdrive.newOverdrive", "Overdrive*", "void"},
    {"sound.effect.overdrive.freeOverdrive", "void", "Overdrive* filter"},
    {"sound.effect.overdrive.setGain", "void", "Overdrive* o, float gain"},
    {"sound.effect.overdrive.setLimit", "void", "Overdrive* o, float limit"},
    {"sound.effect.overdrive.setLimitModulator", "void", "Overdrive* o, PDSynthSignalValue* mod"},
    {"sound.effect.overdrive.getLimitModulator", "PDSynthSignalValue*", "Overdrive* o"},
    {"sound.effect.overdrive.setOffset", "void", "Overdrive* o, float offset"},
    {"sound.effect.overdrive.setOffsetModulator", "void", "Overdrive* o, PDSynthSignalValue* mod"},
    {"sound.effect.overdrive.getOffsetModulator", "PDSynthSignalValue*", "Overdrive* o"},
    {"sound.lfo.newLFO", "PDSynthLFO*", "LFOType type"},
    {"sound.lfo.freeLFO", "void", "PDSynthLFO* lfo"},
    {"sound.lfo.setType", "void", "PDSynthLFO* lfo, LFOType type"},
    {"sound.lfo.setRate", "void", "PDSynthLFO* lfo, float rate"},
    {"sound.lfo.setPhase", "void", "PDSynthLFO* lfo, float phase"},
    {"sound.lfo.setCenter", "void", "PDSynthLFO* lfo, float center"},
    {"sound.lfo.setDepth", "void", "PDSynthLFO* lfo, float depth"},
    {"sound.lfo.setArpeggiation", "void", "PDSynthLFO* lfo, int nSteps, float* steps"},
    {"sound.lfo.setFunction", "void", "PDSynthLFO* lfo, float (*lfoFunc)(PDSynthLFO* lfo, void* userdata), void* userdata, int interpolate"},
    {"sound.lfo.setDelay", "void", "PDSynthLFO* lfo, float holdoff, float ramptime"},
    {"sound.lfo.setRetrigger", "void", "PDSynthLFO* lfo, int flag"},
    {"sound.lfo.getValue", "float", "PDSynthLFO* lfo"},
    {"sound.lfo.setGlobal", "void", "PDSynthLFO* lfo, int global"},
    {"sound.lfo.setStartPhase", "void", "PDSynthLFO* lfo, float phase"},
    {"sound.lfo.setRandomSeed", "void", "PDSynthLFO* lfo, uint16_t value"},
    {"sound.envelope.newEnvelope", "PDSynthEnvelope*", "float attack, float decay, float sustain, float release"},
    {"sound.envelope.freeEnvelope", "void", "PDSynthEnvelope* env"},
    {"sound.envelope.setAttack", "void", "PDSynthEnvelope* env, float attack"},
    {"sound.envelope.setDecay", "void", "PDSynthEnvelope* env, float decay"},
    {"sound.envelope.setSustain", "void", "PDSynthEnvelope* env, float sustain"},
    {"sound.envelope.setRelease", "void", "PDSynthEnvelope* env, float release"},
    {"sound.envelope.setLegato", "void", "PDSynthEnvelope* env, int flag"},
    {"sound.envelope.setRetrigger", "void", "PDSynthEnvelope* lfo, int flag"},
    {"sound.envelope.getValue", "float", "PDSynthEnvelope* env"},
    {"sound.envelope.setCurvature", "void", "PDSynthEnvelope* env, float amount"},
    {"sound.envelope.setVelocitySensitivity", "void", "PDSynthEnvelope* env, float velsens"},
    {"sound.envelope.setRateScaling", "void", "PDSynthEnvelope* env, float scaling, MIDINote start, MIDINote end"},
    {"sound.source.setVolume", "void", "SoundSource* c, float lvol, float rvol"},
    {"sound.source.getVolume", "void", "SoundSource* c, float* outl, float* outr"},
    {"sound.source.isPlaying", "int", "SoundSource* c"},
    {"sound.source.setFinishCallback", "void", "SoundSource* c, sndCallbackProc callback, void* userdata"},
    {"sound.controlsignal.newSignal", "ControlSignal*", "void"},
    {"sound.controlsignal.freeSignal", "void", "ControlSignal* signal"},
    {"sound.controlsignal.clearEvents", "void", "ControlSignal* control"},
    {"sound.controlsignal.addEvent", "void", "ControlSignal* control, int step, float value, int interpolate"},
    {"sound.controlsignal.removeEvent", "void", "ControlSignal* control, int step"},
    {"sound.controlsignal.getMIDIControllerNumber", "int", "ControlSignal* control"},
    {"sound.track.newTrack", "SequenceTrack*", "void"},
    {"sound.track.freeTrack", "void", "SequenceTrack* track"},
    {"sound.track.setInstrument", "void", "SequenceTrack* track, PDSynthInstrument* inst"},
    {"sound.track.getInstrument", "PDSynthInstrument*", "SequenceTrack* track"},
    {"sound.track.addNoteEvent", "void", "SequenceTrack* track, uint32_t step, uint32_t len, MIDINote note, float velocity"},
    {"sound.track.removeNoteEvent", "void", "SequenceTrack* track, uint32_t step, MIDINote note"},
    {"sound.track.clearNotes", "void", "SequenceTrack* track"},
    {"sound.track.getControlSignalCount", "int", "SequenceTrack* track"},
    {"sound.track.getControlSignal", "ControlSignal*", "SequenceTrack* track, int idx"},
    {"sound.track.clearControlEvents", "void", "SequenceTrack* track"},
    {"sound.track.getPolyphony", "int", "SequenceTrack* track"},
    {"sound.track.activeVoiceCount", "int", "SequenceTrack* track"},
    {"sound.track.setMuted", "void", "SequenceTrack* track, int mute"},
    {"sound.track.getLength", "uint32_t", "SequenceTrack* track"},
    {"sound.track.getIndexForStep", "int", "SequenceTrack* track, uint32_t step"},
    {"sound.track.getNoteAtIndex", "int", "SequenceTrack* track, int index, uint32_t* outStep, uint32_t* outLen, MIDINote* outNote, float* outVelocity"},
    {"sound.track.getSignalForController", "ControlSignal*", "SequenceTrack* track, int controller, int create"},
    {"sound.instrument.newInstrument", "PDSynthInstrument*", "void"},
    {"sound.instrument.freeInstrument", "void", "PDSynthInstrument* inst"},
    {"sound.instrument.addVoice", "int", "PDSynthInstrument* inst, PDSynth* synth, MIDINote rangeStart, MIDINote rangeEnd, float transpose"},
    {"sound.instrument.playNote", "PDSynth*", "PDSynthInstrument* inst, float frequency, float vel, float len, uint32_t when"},
    {"sound.instrument.playMIDINote", "PDSynth*", "PDSynthInstrument* inst, MIDINote note, float vel, float len, uint32_t when"},
    {"sound.instrument.setPitchBend", "void", "PDSynthInstrument* inst, float bend"},
    {"sound.instrument.setPitchBendRange", "void", "PDSynthInstrument* inst, float halfSteps"},
    {"sound.instrument.setTranspose", "void", "PDSynthInstrument* inst, float halfSteps"},
    {"sound.instrument.noteOff", "void", "PDSynthInstrument* inst, MIDINote note, uint32_t when"},
    {"sound.instrument.allNotesOff", "void", "PDSynthInstrument* inst, uint32_t when"},
    {"sound.instrument.setVolume", "void", "PDSynthInstrument* inst, float left, float right"},
    {"sound.instrument.getVolume", "void", "PDSynthInstrument* inst, float* left, float* right"},
    {"sound.instrument.activeVoiceCount", "int", "PDSynthInstrument* inst"},
    {"sound.getCurrentTime", "uint32_t", "void"},
    {"sound.addSource", "SoundSource*", "AudioSourceFunction* callback, void* context, int stereo"},
    {"sound.getDefaultChannel", "SoundChannel*", "void"},
    {"sound.addChannel", "int", "SoundChannel* channel"},
    {"sound.removeChannel", "int", "SoundChannel* channel"},
    {"sound.setMicCallback", "int", "RecordCallback* callback, void* context, enum MicSource source"},
    {"sound.getHeadphoneState", "void", "int* headphone, int* headsetmic, void (*changeCallback)(int headphone, int mic)"},
    {"sound.setOutputsActive", "void", "int headphone, int speaker"},
    {"sound.removeSource", "int", "SoundSource* source"},
    {"sound.signal.newSignal", "PDSynthSignal*", "signalStepFunc step, signalNoteOnFunc noteOn, signalNoteOffFunc noteOff, signalDeallocFunc dealloc, void* userdata"},
    {"sound.signal.freeSignal", "void", "PDSynthSignal* signal"},
    {"sound.signal.getValue", "float", "PDSynthSignal* signal"},
    {"sound.signal.setValueScale", "void", "PDSynthSignal* signal, float scale"},
    {"sound.signal.setValueOffset", "void", "PDSynthSignal* signal, float offset"},
    {"sound.signal.newSignalForValue", "PDSynthSignal*", "PDSynthSignalValue* value"},
    {"sound.getError", "const char*", "void"},
    {"sound.requestMicAccess", "enum accessReply", "const char* purpose, AccessRequestCallback* requestCallback, void* userdata"},
    {"lua.addFunction", "int", "lua_CFunction f, const char* name, const char** outErr"},
    {"lua.registerClass", "int", "const char* name, const lua_reg* reg, const lua_val* vals, int isstatic, const char** outErr"},
    {"lua.pushFunction", "void", "lua_CFunction f"},
    {"lua.indexMetatable", "int", "void"},
    {"lua.stop", "void", "void"},
    {"lua.start", "void", "void"},
    {"lua.getArgCount", "int", "void"},
    {"lua.getArgType", "enum LuaType", "int pos, const char** outClass"},
    {"lua.argIsNil", "int", "int pos"},
    {"lua.getArgBool", "int", "int pos"},
    {"lua.getArgInt", "int", "int pos"},
    {"lua.getArgFloat", "float", "int pos"},
    {"lua.getArgString", "const char*", "int pos"},
    {"lua.getArgBytes", "const char*", "int pos, size_t* outlen"},
    {"lua.getArgObject", "void*", "int pos, char* type, LuaUDObject** outud"},
    {"lua.getBitmap", "LCDBitmap*", "int pos"},
    {"lua.getSprite", "LCDSprite*", "int pos"},
    {"lua.pushNil", "void", "void"},
    {"lua.pushBool", "void", "int val"},
    {"lua.pushInt", "void", "int val"},
    {"lua.pushFloat", "void", "float val"},
    {"lua.pushString", "void", "const char* str"},
    {"lua.pushBytes", "void", "const char* str, size_t len"},
    {"lua.pushBitmap", "void", "LCDBitmap* bitmap"},
    {"lua.pushSprite", "void", "LCDSprite* sprite"},
    {"lua.pushObject", "LuaUDObject*", "void* obj, char* type, int nValues"},
    {"lua.retainObject", "LuaUDObject*", "LuaUDObject* obj"},
    {"lua.releaseObject", "void", "LuaUDObject* obj"},
    {"lua.setUserValue", "void", "LuaUDObject* obj, unsigned int slot"},
    {"lua.getUserValue", "int", "LuaUDObject* obj, unsigned int slot"},
    {"lua.callFunction_deprecated", "void", "const char* name, int nargs"},
    {"lua.callFunction", "int", "const char* name, int nargs, const char** outerr"},
    {"json.initEncoder", "void", "json_encoder* encoder, json_writeFunc* write, void* userdata, int pretty"},
    {"json.decode", "int", "struct json_decoder* functions, json_reader reader, json_value* outval"},
    {"json.decodeString", "int", "struct json_decoder* functions, const char* jsonString, json_value* outval"},
    {"scoreboards.addScore", "int", "const char *boardId, uint32_t value, AddScoreCallback callback"},
    {"scoreboards.getPersonalBest", "int", "const char *boardId, PersonalBestCallback callback"},
    {"scoreboards.freeScore", "void", "PDScore *score"},
    {"scoreboards.getScoreboards", "int", "BoardsListCallback callback"},
    {"scoreboards.freeBoardsList", "void", "PDBoardsList *boardsList"},
    {"scoreboards.getScores", "int", "const char *boardId, ScoresCallback callback"},
    {"scoreboards.freeScoresList", "void", "PDScoresList *scoresList"},
    {"network.http.requestAccess", "enum accessReply", "const char* server, int port, bool usessl, const char* purpose, AccessRequestCallback* requestCallback, void* userdata"},
    {"network.http.newConnection", "HTTPConnection*", "const char* server, int port, bool usessl"},
    {"network.http.retain", "HTTPConnection*", "HTTPConnection* http"},
    {"network.http.release", "void", "HTTPConnection* http"},
    {"network.http.setConnectTimeout", "void", "HTTPConnection* connection, int ms"},
    {"network.http.setKeepAlive", "void", "HTTPConnection* connection, bool keepalive"},
    {"network.http.setByteRange", "void", "HTTPConnection* connection, int start, int end"},
    {"network.http.setUserdata", "void", "HTTPConnection* connection, void* userdata"},
    {"network.http.getUserdata", "void*", "HTTPConnection* connection"},
    {"network.http.get", "PDNetErr", "HTTPConnection* conn, const char* path, const char* headers, size_t headerlen"},
    {"network.http.post", "PDNetErr", "HTTPConnection* conn, const char* path, const char* headers, size_t headerlen, const char* body, size_t bodylen"},
    {"network.http.query", "PDNetErr", "HTTPConnection* conn, const char* method, const char* path, const char* headers, size_t headerlen, const char* body, size_t bodylen"},
    {"network.http.getError", "PDNetErr", "HTTPConnection* connection"},
    {"network.http.getProgress", "void", "HTTPConnection* conn, int* read, int* total"},
    {"network.http.getResponseStatus", "int", "HTTPConnection* connection"},
    {"network.http.getBytesAvailable", "size_t", "HTTPConnection* conn"},
    {"network.http.setReadTimeout", "void", "HTTPConnection* conn, int ms"},
    {"network.http.setReadBufferSize", "void", "HTTPConnection* conn, int bytes"},
    {"network.http.read", "int", "HTTPConnection* conn, void* buf, unsigned int buflen"},
    {"network.http.close", "void", "HTTPConnection* connection"},
    {"network.http.setHeaderReceivedCallback", "void", "HTTPConnection* connection, HTTPHeaderCallback* headercb"},
    {"network.http.setHeadersReadCallback", "void", "HTTPConnection* connection, HTTPConnectionCallback* callback"},
    {"network.http.setResponseCallback", "void", "HTTPConnection* connection, HTTPConnectionCallback* callback"},
    {"network.http.setRequestCompleteCallback", "void", "HTTPConnection* connection, HTTPConnectionCallback* callback"},
    {"network.http.setConnectionClosedCallback", "void", "HTTPConnection* connection, HTTPConnectionCallback* callback"},
    {"network.tcp.requestAccess", "enum accessReply", "const char* server, int port, bool usessl, const char* purpose, AccessRequestCallback* requestCallback, void* userdata"},
    {"network.tcp.newConnection", "TCPConnection*", "const char* server, int port, bool usessl"},
    {"network.tcp.retain", "TCPConnection*", "TCPConnection* http"},
    {"network.tcp.release", "void", "TCPConnection* http"},
    {"network.tcp.getError", "PDNetErr", "TCPConnection* connection"},
    {"network.tcp.setConnectTimeout", "void", "TCPConnection* connection, int ms"},
    {"network.tcp.setUserdata", "void", "TCPConnection* connection, void* userdata"},
    {"network.tcp.getUserdata", "void*", "TCPConnection* connection"},
    {"network.tcp.open", "PDNetErr", "TCPConnection* conn, TCPOpenCallback cb, void* ud"},
    {"network.tcp.close", "PDNetErr", "TCPConnection* conn"},
    {"network.tcp.setConnectionClosedCallback", "void", "TCPConnection* conn, TCPConnectionCallback* callback"},
    {"network.tcp.setReadTimeout", "void", "TCPConnection* conn, int ms"},
    {"network.tcp.setReadBufferSize", "void", "TCPConnection* conn, int bytes"},
    {"network.tcp.getBytesAvailable", "size_t", "TCPConnection* conn"},
    {"network.tcp.read", "int", "TCPConnection* conn, void *buffer, size_t length"},
    {"network.tcp.write", "int", "TCPConnection* conn, const void *buffer, size_t length"},
    {"network.tcp.getSentBytesPending", "size_t", "TCPConnection* conn"},
    {"network.getStatus", "WifiStatus", "void"},
    {"network.setEnabled", "void", "bool flag, void (*callback)(PDNetErr err)"},
};
